## EL_Lab9_buildroot/qtcalc/Config.in
```kconfig
config BR2_PACKAGE_QTCALC
	bool "qtcalc"
	depends on BR2_PACKAGE_QT6BASE
	depends on BR2_PACKAGE_QT6DECLARATIVE
	help
	  My custom Qt6/QML Calculator App
```

## EL_Lab9_buildroot/qtweather/Config.in
```kconfig
config BR2_PACKAGE_QTWEATHER
	bool "qtweather"
	depends on BR2_PACKAGE_QT6BASE
	depends on BR2_PACKAGE_QT6DECLARATIVE
	help
	  My custom Qt6/QML Weather app
```
